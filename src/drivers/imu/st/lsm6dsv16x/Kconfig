## src/drivers/imu/st/lsm6dsv16x/Kconfig
```kconfig
menuconfig DRIVERS_IMU_ST_LSM6DSV16X
	bool "lsm6dsv16x"
	default n
	---help---
		Enable support for lsm6dsv16x
```

## src/drivers/wbot_main_driver/Kconfig
```kconfig
menuconfig DRIVERS_WBOT_MAIN_DRIVER
	bool "wbot_main_driver"
	default n
	---help---
		Enable support for Water Robot Main Driver
```

## src/modules/wbot_actuator_bridge/Kconfig
```kconfig
menuconfig MODULES_WBOT_ACTUATOR_BRIDGE
	bool "wbot_actuator_bridge"
	default y
	---help---
		Bridge PX4 actuator_motors outputs to wbot_ctrl_moto messages.
```

## src/modules/wbot_mix_out/Kconfig
```kconfig
menuconfig MODULES_WBOT_MIX_OUT
	bool "wbot_mix_out"
	default n
	---help---
		Enable support for Water Robot Main Driver
```

## src/modules/wbot_moto_test/Kconfig
```kconfig
menuconfig MODULES_WBOT_MOTO_TEST
	bool "wbot_moto_test"
	default n
	---help---
		Enable support for wbot moto test
```
